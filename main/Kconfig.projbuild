## main/Kconfig.projbuild
```kconfig
menu "BMS_LIB RS485 Example Configuration"

    orsource "$IDF_PATH/examples/common_components/env_caps/$IDF_TARGET/Kconfig.env_caps"

    config BMS_LIB_UART_PORT_NUM
        int "UART port number for the connection to the inverter supporting Lib protocol"
        range 0 2 if IDF_TARGET_ESP32 || IDF_TARGET_ESP32S3
        default 1 if IDF_TARGET_ESP32 || IDF_TARGET_ESP32S3
        help
            UART communication port number for the connection to the inverter supporting Lib protocol.
            See UART documentation for available port numbers.

    config BMS_LIB_UART_BAUD_RATE
        int "UART communication speed with inverter supporting Lib protocol"
        range 1200 115200
        default 9600
        help
            UART communication speed with inverter supporting Lib protocol.

    config BMS_LIB_UART_RXD
        int "UART RXD pin number connected to the inverter supporting Lib protocol"
        range ENV_GPIO_RANGE_MIN ENV_GPIO_IN_RANGE_MAX
        default 22 if IDF_TARGET_ESP32
        default 8 if !IDF_TARGET_ESP32
        help
            GPIO number for UART RX pin connected to inverter supporting Lib protocol. See UART 
            documentation for more information about available pin numbers for UART.

    config BMS_LIB_UART_TXD
        int "UART TXD pin number connected to the inverter supporting Lib protocol"
        range ENV_GPIO_RANGE_MIN ENV_GPIO_OUT_RANGE_MAX
        default 23 if IDF_TARGET_ESP32
        default 9 if !IDF_TARGET_ESP32
        help
            GPIO number for UART TX pin connected to inverter supporting Lib protocol. See UART 
            documentation for more information about available pin numbers for UART.

    config JK_UART_PORT_NUM
        int "UART port number for the connection to the JK BMS"
        range 0 2 if IDF_TARGET_ESP32 || IDF_TARGET_ESP32S3
        default 2 if IDF_TARGET_ESP32 || IDF_TARGET_ESP32S3
        help
            UART communication port number for the connection to the JK BMS.
            See UART documentation for available port numbers.

    config JK_UART_BAUD_RATE
        int "UART communication speed with JK BMS"
        range 1200 115200
        default 115200
        help
            UART communication speed with JK BMS.

    config JK_UART_RXD
        int "UART RXD pin number for the connection to JK BMS"
        range ENV_GPIO_RANGE_MIN ENV_GPIO_IN_RANGE_MAX
        default 16 if IDF_TARGET_ESP32
        help
            GPIO number for UART RX pin connected to JK BMS. See UART documentation 
            for more information about available pin numbers for UART.

    config JK_UART_TXD
        int "UART TXD pin number for the connection to JK BMS"
        range ENV_GPIO_RANGE_MIN ENV_GPIO_OUT_RANGE_MAX
        default 17 if IDF_TARGET_ESP32
        help
            GPIO number for UART TX pin connected to JK BMS. See UART documentation 
            for more information about available pin numbers for UART.

endmenu
```
